## conf/layer.conf
```bitbake
BBPATH .= ":${LAYERDIR}"

BBFILES += "${LAYERDIR}/recipes-*/*/*.bb \
            ${LAYERDIR}/recipes-*/*/*.bbappend"

BBFILE_COLLECTIONS += "iot-gateway-hardened"
BBFILE_PATTERN_iot-gateway-hardened = "^${LAYERDIR}/"
BBFILE_PRIORITY_iot-gateway-hardened = "10"

LAYERDEPENDS_iot-gateway-hardened = "core"
LAYERSERIES_COMPAT_iot-gateway-hardened = "scarthgap"
```
